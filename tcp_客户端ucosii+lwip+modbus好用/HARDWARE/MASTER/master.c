/*
*
*	主机服务程序
*
*/

#include"master.h"
#include"usart.h"
#include"delay.h"
#include "tcp_client_demo.h"

u8 ready=0;	
u8 FLAG_caiji;	   //等于0时，采集电压，等于1时,采集内阻
extern u8 index_qd;
u8 n=0;
extern u8 tcp_client_sendbuf[];

void construct_rtu_frm ( u8 *dst_buf,u8 *src_buf,u8 lenth)
{
    unsigned short  crc_tmp;
    crc_tmp = crc16(src_buf, lenth);	
    *(src_buf+lenth) = crc_tmp >> 8 ;
    *(src_buf+lenth+1) = crc_tmp & 0xff;
    lenth++;
    lenth++;
    while ( lenth--)
    {
       *dst_buf = *src_buf;
       dst_buf++;
       src_buf++;     
    }
}



u16  rtu_read_hldreg ( u8 board_adr,u8 *com_buf,u16 start_address,u16 lenth) //03
{

    unsigned char tmp[32], tmp_lenth;   
    tmp[0] = board_adr;
    tmp[1] = READ_HLD_REG;
    tmp[2] = HI(start_address);
    tmp[3] = LOW(start_address);
    tmp[4] = HI(lenth);
    tmp[5] = LOW(lenth);
    tmp_lenth = 6;
    construct_rtu_frm ( com_buf,tmp,tmp_lenth);
	  sendCount=8;
	  beginSend();
    return 8;//为了防止编译器报错//
}

// u16 rtu_set_hldreg( u8 board_adr,u8 *com_buf, u16 start_address, u16 value )//06
// {
//     unsigned char tmp[32], tmp_lenth;   
//     tmp[0] = board_adr;
//     tmp[1] = SET_HLD_REG;
//     tmp[2] = HI(start_address);
//     tmp[3] = LOW(start_address);
//     tmp[4] = HI(value);
//     tmp[5] = LOW(value);  
//     tmp_lenth = 6;
//     construct_rtu_frm ( com_buf, tmp, tmp_lenth);
// 	sendCount2=8;
// 	beginSend2();
//     return 8 ;

// }

int rtu_data_anlys( u8  *dest_p, u8 *source_p, u16 data_start_address, u16 fr_lenth)//rtu 接收分析//
{
    u16 crc_result, crc_tmp;
    u8 tmp1; 
		 
	crc_tmp = *(source_p + fr_lenth-2); // crc  第一字节//
 	crc_tmp = crc_tmp * 256 + *( source_p+fr_lenth-1); // CRC 值// 
	crc_result = crc16(source_p, fr_lenth-2); // 计算CRC 值
//  if ( crc_tmp != crc_result ) // CRC 校验正确//
	if ( crc_tmp == crc_result ) // CRC 校验正确//
    {
// 		hld_reg[0x31]++;
// 		return -1;
//	}
		switch ( *(source_p+1) ) // 功能码//
		{
// 		   case READ_COIL:                   //读取继电器状态//
// 		   for ( tmp1=0; tmp1<*( source_p+2); tmp1++)
// 		   {
// 				shift = 1;
// 				for ( tmp2=0; tmp2<8; tmp2++)
// 				{ 
// 					 *(dest_p+data_start_address+tmp1*8+tmp2) = shift & *( source_p+3);
// 					 *( source_p+3) >>= 1;          
// 				}
// 		   }
// 		   break;
// 		   case READ_DI: //读取开关量输入//
// 		   for ( tmp1=0; tmp1<*( source_p+2); tmp1++)
// 		   {
// 				shift = 1;
// 				for (tmp2=0; tmp2<8; tmp2 ++)
// 				{ 
// 					*(dest_p+data_start_address+tmp1*8+tmp2) = shift & *( source_p+3);
// 					*( source_p+3)>>=1;             
// 				}
// 		   }
// 		   break;
		   case READ_HLD_REG:  //读取保持寄存器//
		   for ( tmp1=0; tmp1<*( source_p+2); tmp1++)
		   {
				//relay17_he;
				*(dest_p + data_start_address+ tmp1)= *( source_p+tmp1+3) ;
				//relay17_he;        
		   }
		   break ;
// 		   case 4:      //读取模拟量输入//
// 		   for ( tmp1=0; tmp1<*( source_p+2); tmp1+=2)
// 		   {
// 				*(dest_p + data_start_address+ tmp1/2) = *( source_p+tmp1+3)*256 +  *( source_p+tmp1+4) ;      
// 		   }
// 		   break;
		   case PROTOCOL_EXCEPTION:
		   return -1*PROTOCOL_ERR;     //整数转换导致类型变化的迹象
		   //break;
		   default:
		   return -1*PROTOCOL_ERR;		//整数转换导致类型变化的迹象
		   // break;
		}
	}
	return 0;	
}


void modbus_rtu(void) //电压读取命令
{
	
	u8 t;
	modbus_com2_over=2;
	if(modbus_com2_over==2&&receBuf[0]==1)
	{
		modbus_com2_over=0;
		rtu_data_anlys(value,receBuf,0,21);	
		for(t=0;t<16;t++)
    {
			tcp_client_sendbuf[t+6]=value[t];
//			printf("%d",t);
		}	
		ready =1;
	}
	else if(modbus_com2_over==2&&receBuf[0]==2)
	{
		modbus_com2_over=0;
		rtu_data_anlys(value,receBuf,16,21);	      
    for(t=16;t<32;t++)
    {
			tcp_client_sendbuf[t+6]=value[t];
		}
		ready =1; 
	}
	else if(modbus_com2_over==2&&receBuf[0]==3)
	{
		modbus_com2_over=0;
		rtu_data_anlys(value,receBuf,32,11);
    for(t=32;t<38;t++)
    {
			tcp_client_sendbuf[t+6]=value[t];
//			printf("%x",value[t]);
//			printf("%d",t);
		}
		ready =1;
	}
// 	else
// 	{
// 		 for(t=0;t<38;t++)
// 			tcp_client_databuf[t+4]=0x55;
// 		ready =1;
// 	}
	receCount=0;
   
	if(slaveraddr==1)
	{
		rtu_read_hldreg(slaveraddr,sendBuf,0,8);
		slaveraddr=2;
	}
	else if(slaveraddr==2) 
	{
		rtu_read_hldreg(slaveraddr,sendBuf,0,8);
		slaveraddr=3;
	}
	else
	{
		rtu_read_hldreg(3,sendBuf,0,3);
		slaveraddr=1;
	}	
	//memset(receBuf,0,100);
}


const u8 auchCRCHi[] = { 
0x00, 0xC1, 0x81, 0x40, 0x01, 0xC0, 0x80, 0x41, 0x01, 0xC0,0x80, 0x41, 0x00, 0xC1, 0x81, 0x40, 0x01, 0xC0, 0x80, 0x41, 
0x00, 0xC1, 0x81, 0x40, 0x00, 0xC1, 0x81, 0x40, 0x01, 0xC0,0x80, 0x41, 0x01, 0xC0, 0x80, 0x41, 0x00, 0xC1, 0x81, 0x40, 
0x00, 0xC1, 0x81, 0x40, 0x01, 0xC0, 0x80, 0x41, 0x00, 0xC1,0x81, 0x40, 0x01, 0xC0, 0x80, 0x41, 0x01, 0xC0, 0x80, 0x41, 
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0x00, 0xC1, 0x81, 0x40, 0x01, 0xC0, 0x80, 0x41, 0x01, 0xC0,0x80, 0x41, 0x00, 0xC1, 0x81, 0x40} ; 


const u8 auchCRCLo[] = { 
0x00, 0xC0, 0xC1, 0x01, 0xC3, 0x03, 0x02, 0xC2, 0xC6, 0x06,0x07, 0xC7, 0x05, 0xC5, 0xC4, 0x04, 0xCC, 0x0C, 0x0D, 0xCD, 
0x0F, 0xCF, 0xCE, 0x0E, 0x0A, 0xCA, 0xCB, 0x0B, 0xC9, 0x09,0x08, 0xC8, 0xD8, 0x18, 0x19, 0xD9, 0x1B, 0xDB, 0xDA, 0x1A, 
0x1E, 0xDE, 0xDF, 0x1F, 0xDD, 0x1D, 0x1C, 0xDC, 0x14, 0xD4,0xD5, 0x15, 0xD7, 0x17, 0x16, 0xD6, 0xD2, 0x12, 0x13, 0xD3, 
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0x44, 0x84, 0x85, 0x45, 0x87, 0x47, 0x46, 0x86, 0x82, 0x42,0x43, 0x83, 0x41, 0x81, 0x80, 0x40} ;
u16 crc16(u8 *puchMsg, u16 usDataLen) 
{ 
	u8 uchCRCHi = 0xFF ; 
	u8 uchCRCLo = 0xFF ; 
	u32 uIndex ; 
	while (usDataLen--) 
	{ 
		uIndex = uchCRCHi ^ *puchMsg++ ; 
		uchCRCHi = uchCRCLo ^ auchCRCHi[uIndex] ; 
		uchCRCLo = auchCRCLo[uIndex] ; 
	} 
	return (uchCRCHi << 8 | uchCRCLo) ; 
}//uint16 crc16(uint8 *puchMsg, uint16 usDataLen)

















